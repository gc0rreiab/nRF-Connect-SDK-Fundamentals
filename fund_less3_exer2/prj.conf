## kconfig
```
source "Kconfig.zephyr"
config MYFUNCTION
	bool "Enable my function"
	default n
```

## prj.conf
```kconfig
#Enable build system include the custom file myfunction.c 
CONFIG_MYFUNCTION=y
```

## nrf52840dk_nrf52840.overlay
```dts
// To get started, press Ctrl+Space (or Option+Esc) to bring up the completion menu and view the available nodes.

// You can also use the buttons in the sidebar to perform actions on nodes.
// Actions currently available include:

// * Enabling / disabling the node
// * Adding the bus to a bus
// * Removing the node
// * Connecting ADC channels

// For more help, browse the DeviceTree documentation at https://docs.zephyrproject.org/latest/guides/dts/index.html
// You can also visit the nRF DeviceTree extension documentation at https://nrfconnect.github.io/vscode-nrf-connect/devicetree/nrfdevicetree.html


&uart0 {
    current-speed = < 9600 >;
};
```

## src/main.c
```c
#include <zephyr/kernel.h>
#include <zephyr/sys/printk.h>
#ifdef CONFIG_MYFUNCTION
#include "myfunction.h"
#endif

void main(void)
{
	while(1){
		#ifdef CONFIG_MYFUNCTION
		int a = 3, b = 4;
		printk("The sum of %d and %d is %d\n\r", a, b, sum(a,b));
		#else
		printk("MYFUNCTION not enabled\r\n");
		return;
		#endif
		k_msleep(1000);
	}
}
```
