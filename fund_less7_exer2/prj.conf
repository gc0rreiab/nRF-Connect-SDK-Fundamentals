## prj.conf
```kconfig
CONFIG_PRINTK=y

# Add configurations to enable timeslicing:
# Enable Timeslicing feature
CONFIG_TIMESLICING=y
# TIMESLICE_SIZE is the max time (in ms) that the current running thread has before it is forcefully preempted by the scheduler to allow the other equal priority threads to run.
CONFIG_TIMESLICE_SIZE=10
# TIMESLICE_PRIORITY is a priority threshold for time slicing, meaning threads with higher priority than this threshold are not subject to time slicing.
CONFIG_TIMESLICE_PRIORITY=0
```

## src/main.c
```c
#include <zephyr/kernel.h>
#include <zephyr/sys/printk.h>

#define STACKSIZE 1024

/* STEP 5 - Change the priority of thread0 to 6 */
#define THREAD0_PRIORITY 7
#define THREAD1_PRIORITY 7

void thread0(void)
{
        while (1)
        {
                printk("Hello, I am thread0\n");
                // execute a do-nothing loop for a specified time in microseconds.
                k_busy_wait(1000000);
        }
}

void thread1(void)
{
        while (1)
        {
                printk("Hello, I am thread1\n");
                // execute a do-nothing loop for a specified time in microseconds.
                k_busy_wait(1000000);
        }
}

K_THREAD_DEFINE(thread0_id, STACKSIZE, thread0, NULL, NULL, NULL,
                THREAD0_PRIORITY, 0, 0);
K_THREAD_DEFINE(thread1_id, STACKSIZE, thread1, NULL, NULL, NULL,
                THREAD1_PRIORITY, 0, 0);
```
